## config/boards/arm/toan/Kconfig.defconfig
```kconfig
if BOARD_TOAN

config ZMK_KEYBOARD_NAME
	default "Toan40"

if USB

config USB_NRFX
	default y

config USB_DEVICE_STACK
	default y

endif # USB

config BT_CTLR
	default BT

config ZMK_BLE
	default y

config ZMK_USB
	default y

endif # 
```

## config/boards/arm/toan/toan_defconfig
```kconfig
CONFIG_SOC_SERIES_NRF52X=y
CONFIG_SOC_NRF52833_QIAA=y
CONFIG_BOARD_TOAN=y

# Enable MPU
CONFIG_ARM_MPU=y

# Enable both USB and BLE
CONFIG_ZMK_USB=y
CONFIG_ZMK_BLE=y

# enable GPIO
CONFIG_GPIO=y

# Enable writing to flash
CONFIG_USE_DT_CODE_PARTITION=y
CONFIG_MPU_ALLOW_FLASH_WRITE=y
CONFIG_NVS=y
CONFIG_SETTINGS_NVS=y
CONFIG_FLASH=y
CONFIG_FLASH_PAGE_LAYOUT=y
CONFIG_FLASH_MAP=y
CONFIG_BUILD_OUTPUT_UF2=y

# Debounce
CONFIG_ZMK_KSCAN_DEBOUNCE_PRESS_MS=15
CONFIG_ZMK_KSCAN_DEBOUNCE_RELEASE_MS=15
CONFIG_ZMK_KSCAN_EVENT_QUEUE_SIZE=8

CONFIG_BT_CTLR_TX_PWR_PLUS_8=y
```
